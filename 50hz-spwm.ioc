# file: 50hz-spwm.ioc
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Mcu.Family=STM32F4
Mcu.Name=STM32F401C(B-C)Ux
Mcu.Package=UFQFPN48
NVIC.PriorityGroup=NVIC_PRIORITYGROUP_4
PA13.Mode=Serial_Wire
PA13.Signal=SYS_JTMS-SWDIO
PA14.Mode=Serial_Wire
PA14.Signal=SYS_JTCK-SWCLK
PC13-ANTI_TAMP.GPIO_Label=led
PC13-ANTI_TAMP.Signal=GPIO_Output
PC14-OSC32_IN.Mode=LSE-External-Oscillator
PC14-OSC32_IN.Signal=RCC_OSC32_IN
PC15-OSC32_OUT.Mode=LSE-External-Oscillator
PC15-OSC32_OUT.Signal=RCC_OSC32_OUT
PH0\ -\ OSC_IN.Mode=HSE-External-Oscillator
PH0\ -\ OSC_IN.Signal=RCC_OSC_IN
PH1\ -\ OSC_OUT.Mode=HSE-External-Oscillator
PH1\ -\ OSC_OUT.Signal=RCC_OSC_OUT
ProjectManager.HeapSize=0x200
ProjectManager.StackSize=0x400
ProjectManager.TargetToolchain=CMake
RCC.48MHZClocksFreq_Value=48000000
RCC.AHBFreq_Value=84000000
RCC.APB1CLKDivider=RCC_HCLK_DIV2
RCC.APB1Freq_Value=42000000
RCC.APB1TimFreq_Value=84000000
RCC.APB2Freq_Value=84000000
RCC.APB2TimFreq_Value=84000000
RCC.CortexFreq_Value=84000000
RCC.HCLKFreq_Value=84000000
RCC.HSE_VALUE=25000000
RCC.HSI_VALUE=16000000
RCC.PLLM=25
RCC.PLLN=336
RCC.PLLP=RCC_PLLP_DIV4
RCC.PLLQ=7
RCC.PLLSourceVirtual=RCC_PLLSOURCE_HSE
RCC.RCC_RTC_Clock_Source=RCC_RTCCLKSOURCE_LSE
RCC.RCC_RTC_Clock_SourceVirtual=RCC_RTCCLKSOURCE_LSE
RCC.SYSCLKFreq_VALUE=84000000
RCC.SYSCLKSource=RCC_SYSCLKSOURCE_PLLCLK
RCC.VCOOutputFreq_Value=336000000
board=custom

// file: Core/Src/main.c
/* USER CODE BEGIN Header */
/**
  ******************************************************************************
  * @file           : main.c
  * @brief          : Main program body
  ******************************************************************************
  * @attention
  *
  * Copyright (c) 2025 STMicroelectronics.
  * All rights reserved.
  *
  * This software is licensed under terms that can be found in the LICENSE file
  * in the root directory of this software component.
  * If no LICENSE file comes with this software, it is provided AS-IS.
  *
  ******************************************************************************
  */
/* USER CODE END Header */
#include "main.h"

void SystemClock_Config(void);
/* USER CODE BEGIN PFP */
static void System_Init_NoHAL(void);
static void GPIO_Init_NoHAL(void);
static void TIM1_PWM_50Hz_Init_NoHAL(void);
static void TIM10_Init_NoHAL(void);
void delay_us(uint32_t us);
void delay_ms(uint32_t ms);
/* USER CODE END PFP */

int main(void)
{

  /* MCU Configuration--------------------------------------------------------*/

  /* USER CODE BEGIN Init */
  /* System initialization without HAL */
  System_Init_NoHAL();
  /* USER CODE END Init */

  /* Configure the system clock */
  SystemClock_Config();

  /* Initialize all configured peripherals */
  /* USER CODE BEGIN 2 */
  GPIO_Init_NoHAL();
  TIM1_PWM_50Hz_Init_NoHAL();
  TIM10_Init_NoHAL();
  /* USER CODE END 2 */

  /* Infinite loop */
  while (1)
  {

    /* USER CODE BEGIN 3 */
    // Toggle LED on PC13 using direct register access
    GPIOC->ODR ^= GPIO_PIN_13;

    // Precise 500ms delay using TIM10
    delay_ms(500);
  }
  /* USER CODE END 3 */
}

void SystemClock_Config(void)
{
  RCC_OscInitTypeDef RCC_OscInitStruct = {0};
  RCC_ClkInitTypeDef RCC_ClkInitStruct = {0};

  /** Configure the main internal regulator output voltage
  */
  __HAL_RCC_PWR_CLK_ENABLE();
  __HAL_PWR_VOLTAGESCALING_CONFIG(PWR_REGULATOR_VOLTAGE_SCALE2);

  /** Initializes the RCC Oscillators according to the specified parameters
  * in the RCC_OscInitTypeDef structure.
  */
  RCC_OscInitStruct.OscillatorType = RCC_OSCILLATORTYPE_HSE;
  RCC_OscInitStruct.HSEState = RCC_HSE_ON;
  RCC_OscInitStruct.PLL.PLLState = RCC_PLL_ON;
  RCC_OscInitStruct.PLL.PLLSource = RCC_PLLSOURCE_HSE;
  RCC_OscInitStruct.PLL.PLLM = 25;
  RCC_OscInitStruct.PLL.PLLN = 336;
  RCC_OscInitStruct.PLL.PLLP = RCC_PLLP_DIV4;
  RCC_OscInitStruct.PLL.PLLQ = 7;
  if (HAL_RCC_OscConfig(&RCC_OscInitStruct) != HAL_OK)
  {
    Error_Handler();
  }

  /** Initializes the CPU, AHB and APB buses clocks
  */
  RCC_ClkInitStruct.ClockType = RCC_CLOCKTYPE_HCLK|RCC_CLOCKTYPE_SYSCLK
                              |RCC_CLOCKTYPE_PCLK1|RCC_CLOCKTYPE_PCLK2;
  RCC_ClkInitStruct.SYSCLKSource = RCC_SYSCLKSOURCE_PLLCLK;
  RCC_ClkInitStruct.AHBCLKDivider = RCC_SYSCLK_DIV1;
  RCC_ClkInitStruct.APB1CLKDivider = RCC_HCLK_DIV2;
  RCC_ClkInitStruct.APB2CLKDivider = RCC_HCLK_DIV1;

  if (HAL_RCC_ClockConfig(&RCC_ClkInitStruct, FLASH_LATENCY_2) != HAL_OK)
  {
    Error_Handler();
  }
}

/**
  * @brief GPIO Initialization without HAL - direct register access
  * @param None
  * @retval None
  */
static void GPIO_Init_NoHAL(void)
{

  /* GPIO Ports Clock Enable - direct register access */
  RCC->AHB1ENR |= RCC_AHB1ENR_GPIOCEN;  // Enable GPIOC clock
  RCC->AHB1ENR |= RCC_AHB1ENR_GPIOAEN;  // Enable GPIOA clock

  // Wait for clocks to stabilize
  __DSB();

  /*Configure PC13 as output (LED) - direct register access
   * PC13 -> bit 13
   * MODER: 00 = Input, 01 = Output, 10 = Alternate, 11 = Analog
   * OTYPER: 0 = Push-pull, 1 = Open-drain
   * OSPEEDR: 00 = Low, 01 = Medium, 10 = High, 11 = Very High
   * PUPDR: 00 = No pull, 01 = Pull-up, 10 = Pull-down, 11 = Reserved
   */

  // Set PC13 to Output mode (01 in MODER bits 27:26)
  GPIOC->MODER &= ~(0x3UL << (13 * 2));   // Clear bits
  GPIOC->MODER |= (0x1UL << (13 * 2));    // Set to Output (01)

  // Set PC13 to Push-Pull (0 in OTYPER bit 13)
  GPIOC->OTYPER &= ~(1UL << 13);

  // Set PC13 to Low speed (00 in OSPEEDR bits 27:26)
  GPIOC->OSPEEDR &= ~(0x3UL << (13 * 2));

  // Set PC13 to No pull-up/pull-down (00 in PUPDR bits 27:26)
  GPIOC->PUPDR &= ~(0x3UL << (13 * 2));

  // Set initial output level to LOW (LED off)
  GPIOC->ODR &= ~(1UL << 13);

/* USER CODE BEGIN MX_GPIO_Init_2 */
  /*Configure PA8 and PA7 for TIM1 PWM (Alternate Function)
   * PA8 -> TIM1_CH1 (AF1)
   * PA7 -> TIM1_CH1N (AF1 - complementary output)
   */

  // PA8: TIM1_CH1
  GPIOA->MODER &= ~(0x3UL << (8 * 2));    // Clear bits
  GPIOA->MODER |= (0x2UL << (8 * 2));     // Set to Alternate Function (10)
  GPIOA->OTYPER &= ~(1UL << 8);           // Push-pull
  GPIOA->OSPEEDR |= (0x3UL << (8 * 2));   // Very high speed
  GPIOA->PUPDR &= ~(0x3UL << (8 * 2));    // No pull-up/pull-down
  // Set AF1 for PA8 (AFR[1] = AFRH, pin 8)
  GPIOA->AFR[1] &= ~(0xFUL << ((8 - 8) * 4));
  GPIOA->AFR[1] |= (0x1UL << ((8 - 8) * 4));  // AF1

  // PA7: TIM1_CH1N (complementary)
  GPIOA->MODER &= ~(0x3UL << (7 * 2));    // Clear bits
  GPIOA->MODER |= (0x2UL << (7 * 2));     // Set to Alternate Function (10)
  GPIOA->OTYPER &= ~(1UL << 7);           // Push-pull
  GPIOA->OSPEEDR |= (0x3UL << (7 * 2));   // Very high speed
  GPIOA->PUPDR &= ~(0x3UL << (7 * 2));    // No pull-up/pull-down
  // Set AF1 for PA7 (AFR[0] = AFRL, pin 7)
  GPIOA->AFR[0] &= ~(0xFUL << (7 * 4));
  GPIOA->AFR[0] |= (0x1UL << (7 * 4));    // AF1
/* USER CODE END MX_GPIO_Init_2 */
}

/* USER CODE BEGIN 4 */

/**
  * @brief TIM1 PWM 50Hz Initialization without HAL - direct register access
  * @param None
  * @retval None
  *
  * TIM1 configuration for 50 Hz square wave with complementary outputs and dead-time:
  * - APB2 clock: 84 MHz
  * - Target frequency: 50 Hz
  * - Prescaler: 0 (no division)
  * - ARR: 1679 -> 84 MHz / 1680 / 1000 = 50 Hz
  * - CCR1: 840 -> 50% duty cycle (square wave/meander)
  * - Dead-time: ~2 µs (168 ticks at 84 MHz)
  *
  * Outputs:
  * - PA8: TIM1_CH1 (main output)
  * - PA7: TIM1_CH1N (complementary output with dead-time)
  */
static void TIM1_PWM_50Hz_Init_NoHAL(void)
{
  // Enable TIM1 clock (bit 0 in RCC_APB2ENR)
  RCC->APB2ENR |= RCC_APB2ENR_TIM1EN;

  // Wait for clock to stabilize
  __DSB();

  // Configure TIM1 for 50 Hz PWM
  // Formula: Freq = TIM_CLK / ((PSC+1) * (ARR+1))
  // 50 Hz = 84 MHz / (1 * 1680) = 50 kHz / 1000
  TIM1->PSC = 0;              // Prescaler: no division (84 MHz)
  TIM1->ARR = 1679;           // Auto-reload: 84MHz / 1680 = 50 kHz base
                              // With CCR adjustment can create 50 Hz

  // For true 50 Hz square wave, we need:
  // 84 MHz / 50 Hz = 1,680,000 counts per cycle
  // But ARR is 16-bit (max 65535), so we need prescaler
  // Let's use PSC = 49, ARR = 33599
  // 84 MHz / 50 / 33600 = 50 Hz
  TIM1->PSC = 49;             // Prescaler: 84 MHz / 50 = 1.68 MHz
  TIM1->ARR = 33599;          // Auto-reload: 1.68 MHz / 33600 = 50 Hz
  TIM1->CNT = 0;              // Reset counter

  // Configure Channel 1 for PWM mode 1
  // OC1M = 110 (PWM mode 1), OC1PE = 1 (preload enable)
  TIM1->CCMR1 &= ~TIM_CCMR1_OC1M;           // Clear OC1M bits
  TIM1->CCMR1 |= (0x6UL << TIM_CCMR1_OC1M_Pos); // PWM mode 1 (110)
  TIM1->CCMR1 |= TIM_CCMR1_OC1PE;           // Enable preload

  // Set duty cycle to 50% for square wave (meander)
  TIM1->CCR1 = 16800;         // 50% of 33600 = 16800

  // Enable main output (MOE) and configure dead-time
  // Dead-time calculation: DTG = dead_time * f_dtg
  // For ~2 µs at 84 MHz: DTG = 2µs * 84MHz = 168
  // DTG[7:0] in BDTR register
  TIM1->BDTR |= (168 << TIM_BDTR_DTG_Pos);  // Dead-time: ~2 µs
  TIM1->BDTR |= TIM_BDTR_MOE;               // Main Output Enable

  // Enable complementary output polarity (active high for both)
  TIM1->CCER &= ~TIM_CCER_CC1P;             // CH1 polarity: active high
  TIM1->CCER &= ~TIM_CCER_CC1NP;            // CH1N polarity: active high

  // Enable Channel 1 and its complementary output
  TIM1->CCER |= TIM_CCER_CC1E;              // Enable CH1 output (PA8)
  TIM1->CCER |= TIM_CCER_CC1NE;             // Enable CH1N output (PA7)

  // Enable auto-reload preload
  TIM1->CR1 |= TIM_CR1_ARPE;

  // Generate update event to load all preload registers
  TIM1->EGR |= TIM_EGR_UG;

  // Clear update flag
  TIM1->SR &= ~TIM_SR_UIF;

  // Start TIM1
  TIM1->CR1 |= TIM_CR1_CEN;
}

/**
  * @brief System Initialization without HAL - direct register access
  * @param None
  * @retval None
  *
  * Replaces HAL_Init() functionality:
  * - Enable Flash instruction cache
  * - Enable Flash data cache
  * - Enable Flash prefetch buffer
  * - Set NVIC priority grouping
  */
static void System_Init_NoHAL(void)
{
  // Enable Flash instruction cache
  FLASH->ACR |= FLASH_ACR_ICEN;

  // Enable Flash data cache
  FLASH->ACR |= FLASH_ACR_DCEN;

  // Enable Flash prefetch buffer
  FLASH->ACR |= FLASH_ACR_PRFTEN;

  // Set NVIC Priority Grouping to 4 (4 bits for pre-emption priority, 0 bits for subpriority)
  // This matches NVIC_PRIORITYGROUP_4 from HAL
  NVIC_SetPriorityGrouping(0x03); // 0x03 = 4 bits preemption, 0 bits sub-priority

  // Note: We don't need SysTick since we use TIM10 for delays
}

/**
  * @brief TIM10 Initialization without HAL - direct register access
  * @param None
  * @retval None
  *
  * TIM10 configuration:
  * - APB2 clock: 84 MHz
  * - Prescaler: 83 -> 84 MHz / 84 = 1 MHz
  * - Auto-reload: 65535 (max for 16-bit timer)
  * - Timer tick: 1 microsecond
  */
static void TIM10_Init_NoHAL(void)
{
  // Enable TIM10 clock (bit 17 in RCC_APB2ENR)
  RCC->APB2ENR |= RCC_APB2ENR_TIM10EN;

  // Wait for clock to stabilize
  __DSB();

  // Configure TIM10
  TIM10->PSC = 83;          // Prescaler: 84 MHz / 84 = 1 MHz (1 us tick)
  TIM10->ARR = 0xFFFF;      // Auto-reload: maximum value for 16-bit timer
  TIM10->CNT = 0;           // Reset counter

  // Enable auto-reload preload
  TIM10->CR1 |= TIM_CR1_ARPE;

  // Generate update event to load prescaler value
  TIM10->EGR |= TIM_EGR_UG;

  // Clear update flag
  TIM10->SR &= ~TIM_SR_UIF;

  // Start timer
  TIM10->CR1 |= TIM_CR1_CEN;
}

/**
  * @brief Precise microsecond delay using TIM10
  * @param us: delay in microseconds (max ~65535 us per call)
  * @retval None
  */
void delay_us(uint32_t us)
{
  // Reset counter
  TIM10->CNT = 0;

  // Wait for specified microseconds
  while(TIM10->CNT < us);
}

/**
  * @brief Precise millisecond delay using TIM10
  * @param ms: delay in milliseconds
  * @retval None
  */
void delay_ms(uint32_t ms)
{
  for(uint32_t i = 0; i < ms; i++)
  {
    delay_us(1000);  // 1ms = 1000us
  }
}

/* USER CODE END 4 */

void Error_Handler(void)
{
  __disable_irq();
  while (1)
  {
  }
}
